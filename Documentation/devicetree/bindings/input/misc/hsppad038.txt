## Documentation/devicetree/bindings/input/misc/hsppad038.txt
```
ALPS hsppad038 barometer driver

Required properties:

 - compatible           : Should be "alps,hsppad038"
 - reg                          : i2c address of the device.
 - vdd-supply           : Analog power supply needed to power up the device.
```

## drivers/input/misc/yas537/Kconfig
```kconfig
config SENSORS_YAS_MAGNETOMETER_INPUT
	tristate "Yamaha 3-Axis Magnetometer"
	help
	  Say Y here to add support for the Yamaha 3-Axis Magnetometer.

config SENSORS_YAS_ACCELEROMETER_INPUT
	tristate "Yamaha 3-Axis Accelerometer"
	help
	  Say Y here to add support for the Yamaha 3-Axis Accelerometer.
```

## drivers/staging/iio/magnetometer/Kconfig
```kconfig
#
# Magnetometer sensors
#
menu "Magnetometer sensors"

config SENSORS_HMC5843
	tristate "Honeywell HMC5843/5883/5883L 3-Axis Magnetometer"
	depends on I2C
	help
	  Say Y here to add support for the Honeywell HMC5843, HMC5883 and
	  HMC5883L 3-Axis Magnetometer (digital compass).

	  To compile this driver as a module, choose M here: the module
	  will be called hmc5843.

config SENSORS_YAS537
	tristate "Yamaha 3-Axis Magnetometer"
	depends on I2C && SYSFS && IIO && IIO_KFIFO_BUF && IIO_TRIGGER
	help
	  Say Y here to add support for the Yamaha 3-Axis Magnetometer.

config SENSORS_STK8313
	tristate "Yamaha 3-Axis Accelerometer"
	depends on I2C && SYSFS && IIO && IIO_KFIFO_BUF && IIO_TRIGGER
	help
	  Say Y here to add support for the Yamaha 3-Axis Accelerometer.

endmenu
```
