
qcom,BT52_3700mAh_PMI8950GUI20015 {
	/* #2312848_Compal_BT52_3700mAh_averaged_MasterSlave_Feb12th2016*/
	qcom,max-voltage-uv = <4400000>;
	qcom,nom-batt-capacity-mah = <3700>;
	qcom,batt-id-kohm = <0>;
	qcom,battery-beta = <3435>;
	qcom,battery-type = "BT52_3700mAh_PMI8950GUI20015.dtsi";
	qcom,chg-rslow-comp-c1 = <2419422>;
	qcom,chg-rslow-comp-c2 = <2834954>;
	qcom,chg-rs-to-rslow = <449312>;
	qcom,chg-rslow-comp-thr = <0x99>;
	qcom,checksum = <0x2737>;
	qcom,gui-version = "PMI8950GUI - 2.0.0.15";
	qcom,fg-profile-data = [
		 0D 88 09 7F
		 C0 82 27 7D
		 4E 83 5A 68
		 67 73 85 7E
		 26 82 DD 99
		 AB BC 2E C9
		 5E 0D 08 88
		 46 7E 28 82
		 99 7C 4E 83
		 84 70 10 68
		 8F 7E 46 82
		 BC 99 FC BC
		 E9 C9 5C 0D
		 DB 0E C6 60
		 14 70 1B FE
		 9A 46 53 3D
		 CA 41 00 00
		 05 46 FC 2B
		 FE 1A 00 00
		 00 00 00 00
		 00 00 00 00
		 36 68 70 63
		 C5 71 1A 88
		 99 6C 88 60
		 1D 71 65 82
		 FE 67 23 60
		 BA 5B 42 A8
		 1D A8 5A E3
		 57 A0 71 0C
		 28 00 FF 36
		 F0 11 30 03
		 00 00 00 0C
	];
};
